## boards/shields/cygnus463/Kconfig.defcofig
```kconfig
if SHIELD_CYGNUS463_RIGHT

config ZMK_KEYBOARD_NAME
    default "cygnus463"

config ZMK_SPLIT_ROLE_CENTRAL
    default y

endif

if SHIELD_CYGNUS463_LEFT || SHIELD_CYGNUS463_RIGHT

config ZMK_SPLIT
    default y

endif
```

## boards/shields/cygnus463/Kconfig.shield
```kconfig
config SHIELD_CYGNUS463_LEFT
    def_bool $(shields_list_contains,cygnus463_left)

config SHIELD_CYGNUS463_RIGHT
    def_bool $(shields_list_contains,cygnus463_right)
```
